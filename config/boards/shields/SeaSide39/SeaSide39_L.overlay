#include "SeaSide39.dtsi"

&kscan0 {
        col-gpios
            = <&xiao_d 10 GPIO_ACTIVE_HIGH>
            , <&xiao_d 9 GPIO_ACTIVE_HIGH> 
            , <&xiao_d 8 GPIO_ACTIVE_HIGH> 
            , <&xiao_d 7 GPIO_ACTIVE_HIGH> 
            , <&xiao_d 5 GPIO_ACTIVE_HIGH>
            , <&xiao_d 0 GPIO_ACTIVE_HIGH>
            ;
};

/* 充電電流設定: 常に100mA */
&gpio0 {
    charge100mA {
        gpio-hog;
        gpios = <13 GPIO_OUTPUT_LOW>;
        line-name = "charge_100mA";
    };
};
